#include <cstring>
#include <Heli/Display/oled.hpp>

namespace Rpi
{
    enum
    {
        SSD1306_BAUD_RATE = 400000,
        SSD1306_ADDR = 0x3C,

        SSD1306_MULTIPLEX_RATIO = 0xA8,

// registers
        SSD1306_CONTROL_REG = 0x00,  // Co = 0, DC = 0
        SSD1306_DATA_REG = 0x40,

// SSD1306 PARAMETERS
        SSD1306_LCDWIDTH = Oled::WIDTH,
        SSD1306_LCDHEIGHT = Oled::HEIGHT,
        SSD1306_MAXROWS = 7,
        SSD1306_MAXCONTRAST = 0xFF,

// command table
        SSD1306_SETCONTRAST = 0x81,
        SSD1306_DISPLAYALLON_RESUME = 0xA4,
        SSD1306_DISPLAYALLON = 0xA5,
        SSD1306_NORMALDISPLAY = 0xA6,
        SSD1306_INVERTDISPLAY = 0xA7,
        SSD1306_DISPLAYOFF = 0xAE,
        SSD1306_DISPLAYON = 0xAF,

// scrolling commands
        SSD1306_SCROLL_RIGHT = 0x26,
        SSD1306_SCROLL_LEFT = 0x27,
        SSD1306_SCROLL_VERT_RIGHT = 0x29,
        SSD1306_SCROLL_VERT_LEFT = 0x2A,
        SSD1306_SET_VERTICAL = 0xA3,
        SSD1306_SCROLL_DISABLE = 0x2E,

// address setting
        SSD1306_SETLOWCOLUMN = 0x00,
        SSD1306_SETHIGHCOLUMN = 0x10,
        SSD1306_MEMORYMODE = 0x20,
        SSD1306_COLUMNADDRESS = 0x21,
        SSD1306_COLUMNADDRESS_MSB = 0x00,
        SSD1306_COLUMNADDRESS_LSB = 0x7F,
        SSD1306_PAGEADDRESS = 0x22,
        SSD1306_PAGE_START_ADDRESS = 0xB0,

// hardware configuration
        SSD1306_SETSTARTLINE = 0x40,
        SSD1306_SEGREMAP = 0xA1,
        SSD1306_SETMULTIPLEX = 0xA8,
        SSD1306_COMSCANINC = 0xC0,
        SSD1306_COMSCANDEC = 0xC8,
        SSD1306_SETDISPLAYOFFSET = 0xD3,
        SSD1306_SETCOMPINS = 0xDA,

// timing and driving
        SSD1306_SETDISPLAYCLOCKDIV = 0xD5,
        SSD1306_SETPRECHARGE = 0xD9,
        SSD1306_SETVCOMDETECT = 0xDB,
        SSD1306_NOP = 0xE3,

// power supply configuration
        SSD1306_CHARGEPUMP = 0x8D,
        SSD1306_EXTERNALVCC = 0x10,
        SSD1306_INTERNALVCC = 0x14,
        SSD1306_SWITCHCAPVCC = 0x20,
    };

    void Oled::send_command(U8 cmd)
    {
        U8 i2c_data[2] = {SSD1306_CONTROL_REG, cmd};
        i2c_write(i2c_data, 2);
    }

    void Oled::draw()
    {
        U8 i2c_data[2] = {SSD1306_DATA_REG, 0};
        i2c_data[0] = SSD1306_DATA_REG;
        for (U8 data : canvas)
        {
            i2c_data[1] = data;
            i2c_write(i2c_data, 2);
        }
    }

    void Oled::init()
    {
        // init SSD1306 settings
        send_command(SSD1306_DISPLAYOFF);  // Display off
        send_command(SSD1306_MULTIPLEX_RATIO);  // Set Multiplex Ratio
        send_command(0x3F);

        send_command(SSD1306_SETDISPLAYOFFSET);  // Set Display Offset
        send_command(0x00);  // no Offset

        send_command(SSD1306_DATA_REG);  // Set display Start Line
        send_command(SSD1306_SEGREMAP);  // Set Segment Re-Map
        send_command(SSD1306_COMSCANDEC);  // Set COM Output Scan Direction

        send_command(SSD1306_NORMALDISPLAY);
        send_command(SSD1306_SETDISPLAYCLOCKDIV);
        send_command(0x80);

        send_command(SSD1306_SETCOMPINS);  // Set COM Pins Hardware Configuration
        send_command(0x12);

        send_command(SSD1306_SETCONTRAST);  // Set Contrast Control
        send_command(0x7F);

        send_command(SSD1306_DISPLAYALLON_RESUME);  // Set Entire Display On/Off

        send_command(SSD1306_NORMALDISPLAY);  // Set Normal/Inverse Display

        send_command(SSD1306_SETPRECHARGE);  // Set Pre-Charge Period
        send_command(0xF1);  // Snternal

        send_command(SSD1306_SETVCOMDETECT);  // Set VCOMH Deselect Level
        send_command(0x40);

        send_command(SSD1306_SETDISPLAYCLOCKDIV);  // Set Display Clock Divide Ratio\Oscilator Frequency
        send_command(0x80);  // the suggested ratio 0x80

        send_command(SSD1306_CHARGEPUMP);  // Set Charge Pump

        send_command(SSD1306_INTERNALVCC);  // Vcc internal

        send_command(SSD1306_SETLOWCOLUMN);  // Set Lower Column Start Address

        send_command(SSD1306_SETHIGHCOLUMN);  // Set Higher Column Start Address

        send_command(SSD1306_PAGE_START_ADDRESS);  // Set Page Start Address for Page Addressing Mode

        // 00 - Horizontal Addressing Mode
        // 01 - Vertical Addressing Mode
        // 02 - Page Addressing Mode
        send_command(SSD1306_MEMORYMODE);  // Set Memory Addressing Mode
        send_command(0x00);

        send_command(SSD1306_COLUMNADDRESS);  // Set Column Address (only for horizontal or vertical mode)
        send_command(SSD1306_COLUMNADDRESS_MSB);
        send_command(SSD1306_COLUMNADDRESS_LSB);

        send_command(SSD1306_PAGEADDRESS);  // Set Page Address
        send_command(0x00);
        send_command(0x07);

        send_command(SSD1306_SCROLL_DISABLE);  // Deactivate Scroll
        display_on();

        // Clear the display
        clear();
        draw();
        display_on();
    }

    void Oled::clear()
    {
        memset(canvas, 0, sizeof(canvas));
    }

//unsigned char a[]={0x00,0x00,0xC0,0x38,0xE0,0x00,0x00,0x00,0x20,0x3C,0x23,0x02,0x02,0x27,0x38,0x20};

    void Oled::ascii(U32 row, U32 col, char ascii)
    {
        const static U8 ascii_mappings[95][16] = {
                {0x00, 0x00, 0x00, 0x00, 0x00, 0x00, 0x00, 0x00, 0x00, 0x00, 0x00, 0x00, 0x00, 0x00, 0x00, 0x00},//  0
                {0x00, 0x00, 0x00, 0xF8, 0x00, 0x00, 0x00, 0x00, 0x00, 0x00, 0x00, 0x33, 0x30, 0x00, 0x00, 0x00},//! 1
                {0x00, 0x10, 0x0C, 0x06, 0x10, 0x0C, 0x06, 0x00, 0x00, 0x00, 0x00, 0x00, 0x00, 0x00, 0x00, 0x00},//" 2
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                {0x00, 0x06, 0x01, 0x01, 0x02, 0x02, 0x04, 0x04, 0x00, 0x00, 0x00, 0x00, 0x00, 0x00, 0x00, 0x00},//~ 94
        };

        U32 ascii_index = (ascii - ' ');  // correct ascii offset
        FW_ASSERT(ascii_index < sizeof(ascii_mappings) / sizeof(ascii_mappings[0]), ascii_index);

        FW_ASSERT(row < LINE_MAX_N, row);
        FW_ASSERT(col < LINE_LENGTH, row);

        // Copy each vertical portion of the character one at a time
        for (U32 i = 0; i < Oled::CHARACTER_HEIGHT; i++)
        {
            //                  offset to line              offset to column     offset to vertical portion of character
            memcpy(canvas + (row * (Oled::LINE_SIZE)) + (col * Oled::CHARACTER_WIDTH) + (i * Oled::WIDTH),
                    // Grab the portion of the character we want
                   ascii_mappings[ascii_index] + (i * Oled::CHARACTER_WIDTH),
                   Oled::CHARACTER_WIDTH);
        }
    }

    void Oled::line(U32 row, U32 col, const char* ascii_str)
    {
        for (U32 i = 0; i < Oled::LINE_LENGTH; i++)
        {
            // Exit early if the string ends
            if (!ascii_str[i]) break;

            ascii(row, col++, ascii_str[i]);
        }
    }

    void Oled::display_off()
    {
        Oled::send_command(SSD1306_DISPLAYOFF);
    }

    void Oled::display_on()
    {
        Oled::send_command(SSD1306_DISPLAYON);
    }

    void Oled::draw_integer(const U16* camera_in_array, U16 max)
    {
        clear();

        for (I32 i = 0; i < SSD1306_LCDWIDTH; i++)
        {
            // set pixel based on camera_in_array.
            // 0 = top of screen, SCREEN_HEIGHT bottom of screen...
            I32 px_height = SSD1306_LCDHEIGHT - ((camera_in_array[i] * SSD1306_LCDHEIGHT) / (max));
            canvas[i + (SSD1306_LCDWIDTH * (px_height / 8))] |= (1 << (px_height & 7));
        }
    }

    void Oled::draw_floating(const F64* array, U32 n, F64 max, F64 offset)
    {
        clear();

        for(I32 i = 0; i < SSD1306_LCDWIDTH; i++)
        {
            F64 i_f = (((F64) i) / SSD1306_LCDWIDTH) * n;
            // set pixel based on camera_in_array.
            // 0 = top of screen, SCREEN_HEIGHT bottom of screen...
            I32 px_height = SSD1306_LCDHEIGHT - (I32)(((array[(U32)i_f] + offset) * SSD1306_LCDHEIGHT) / max);
            px_height = FW_MAX(px_height, 0);
            px_height = FW_MIN(px_height, SSD1306_LCDHEIGHT - 1);
            canvas[i + (SSD1306_LCDWIDTH * (px_height / 8))] |= (1 << (px_height & 7));
        }
    }

    Oled::Oled()
    : canvas{0}
    {
    }

}